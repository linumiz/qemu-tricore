## hw/tricore/Kconfig
```kconfig
config TRIBOARD
    bool
    default y
    depends on TRICORE
    select UNIMP
    select TC27X_SOC
    select TC39X_SOC

config TC27X_SOC
    bool
    select CAN_BUS
    select TRICORE_ASCLIN
    select TRICORE_IRBUS
    select TRICORE_SCU
    select TRICORE_STM
    select TRICORE_VIRT
    select TRICORE_SFR

config TC39X_SOC
    bool
    select TRICORE_ASCLIN
    select TRICORE_IRBUS
    select TRICORE_SCU
    select TRICORE_STM
    select TRICORE_VIRT
    select TRICORE_SFR

config TRICORE_SCU
    bool

config TRICORE_VIRT
    bool

config TRICORE_SFR
    bool

config TC4X_CLOCK
    bool

config TC4X_CPU
    bool
    depends on TRICORE_IRBUS
    select TRICORE_STM

config TRIBOARD_TC4D7
    bool
    default y
    depends on TRICORE
    select TC4DX_SOC

config TC4DX_SOC
    bool
    select TC4X_CLOCK
    select TC4X_CPU
    select TRICORE_ASCLIN
    select TRICORE_IRBUS
    select TRICORE_SCU
    select TRICORE_STM
    select TRICORE_VIRT
    select TRICORE_SFR
```
